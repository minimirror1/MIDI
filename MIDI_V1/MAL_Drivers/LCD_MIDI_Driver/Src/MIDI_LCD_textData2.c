/*
MIDI LCD text  data

midi lcd 텍스트 픽셀 데이터

*/

#include "main.h"

#include "LCD_MIDI.h"
#include "LCD_MIDI_Control.h"
#include "LCD_MIDI_Logo.h"


#include "MIDI_LCD_textData2.h"
#include <string.h>

LCDtextData_typedef  LCDtext; 

extern LCD_Handle_TypeDef	hlcd;

const uint8_t ASCII_24[128][36] = {    // 4608bytes   가로 : 12, 세로 : 24(8*3)
  {0x00,0x00,0x00,0x00,0x00,0x00,0x00,0x00,0x00,0x00,0x00,0x00, // 0x00
   0x00,0x00,0x00,0x00,0x00,0x00,0x00,0x00,0x00,0x00,0x00,0x00,
   0x00,0x00,0x00,0x00,0x00,0x00,0x00,0x00,0x00,0x00,0x00,0x00},
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  {0x00,0x80,0x80,0x80,0x80,0x80,0x80,0x80,0x80,0x80,0x80,0x00, // 0x1F
   0x00,0x01,0x07,0x1F,0x7F,0xFF,0xFF,0x7F,0x1F,0x07,0x01,0x00,
   0x00,0x00,0x00,0x00,0x00,0x01,0x01,0x00,0x00,0x00,0x00,0x00},
  //{0xff,0xff,0xff,0xff,0xff,0xff,0xff,0xff,0xff,0xff,0xff,0xff, // space
  //0xff,0xff,0xff,0xff,0xff,0xff,0xff,0xff,0xff,0xff,0xff,0xff,
  //0xff,0xff,0xff,0xff,0xff,0xff,0xff,0xff,0xff,0xff,0xff,0xff},
  {0x00,0x00,0x00,0x00,0x00,0x00,0x00,0x00,0x00,0x00,0x00,0x00, // space
   0x00,0x00,0x00,0x00,0x00,0x00,0x00,0x00,0x00,0x00,0x00,0x00,
   0x00,0x00,0x00,0x00,0x00,0x00,0x00,0x00,0x00,0x00,0x00,0x00},
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  {0x00,0x00,0x00,0x3C,0x66,0x42,0x42,0x66,0x3C,0x00,0x00,0x00, // 0x7F
   0x00,0x00,0x00,0x00,0x00,0x00,0x00,0x00,0x00,0x00,0x00,0x00,
   0x00,0x00,0x00,0x00,0x00,0x00,0x00,0x00,0x00,0x00,0x00,0x00}
};




const uint8_t Tsize[3][2] = {
  {12, 24},  // text A
  {24, 36},  // text B
  {36, 48},  // text C 
};

void LCD_pixel_init(LCDtextData_typedef *LCDtext)
{
  for (int i = 0; i<128;i++)
    memset(LCDtext->data[i],0x00,sizeof(uint8_t)*8);
}

//void LCD_pixel_write(LCDtextData_typedef *LCDtext, uint8_t text[], TEXT_SIZE_typedef size)
//{
//  LCDtext->size = size;
//  
// switch (size)
// {
// case TEXT_SIZE_A:
//   
//   break;
// case TEXT_SIZE_B:
//   
//   break;  
// case TEXT_SIZE_C:
//   
//   break;  
// }
//  
//}

void LCD_pixel_write_sizeA(LCDtextData_typedef *LCDtext, uint8_t ascii, uint8_t No)
{
  LCDtext->size = TEXT_SIZE_A;
  // 텍스트 픽셀값 얻기
  uint8_t text[36];
  for(int i=0;i<36;i++)
  {
    text[i] = ASCII_24[ascii][i];
 
  }
  
  // 텍스트 위치 선정
  uint8_t H = 1;
  uint8_t W = 0;
  if (No >= 10)  
  {
    H = 1+4;
    W = (No-10)*12;
  }
  else 
  {
    W = No*12;
  }
  
  //   변수에 데이터 저장
  for (int i=0; i<12; i++)
     LCDtext->data[i+W][H] = text[i];
  H++;
  for (int i=0; i<12; i++)
     LCDtext->data[i+W][H] = text[i+12];
  H++;
  for (int i=0; i<12; i++)
     LCDtext->data[i+W][H] = text[i+24];
  
}


void LCD_Pixel_wirte_newLogo(uint8_t lcdNum)
{
	uint32_t cnt = 0;
	for (int i = 0; i < 8; i++) {
		for (int j = 0; j < 128; j++) {
			hlcd.lcd[lcdNum].frame[i][j] = new_genlogo[cnt];
			cnt++;
		}
	}
}

void LCD_Pixel_wirte_logo(uint8_t lcdNum, char logo)
{
	const unsigned char *pLogo;
	uint32_t cnt = 0;


	switch (logo) {
	case 'E':
		pLogo = &logo_E[0];
		break;
	case 'G':
		pLogo = &logo_G[0];
		break;
	case 'L':
		pLogo = &logo_L[0];
		break;
	case 'M':
		pLogo = &logo_M[0];
		break;
	case 'N':
		pLogo = &logo_N[0];
		break;
	case 'O':
		pLogo = &logo_O[0];
		break;
	case 'R':
		pLogo = &logo_R[0];
		break;
	case 'S':
		pLogo = &logo_S[0];
		break;
	case 'T':
		pLogo = &logo_T[0];
		break;
	case ' ':
		pLogo = &logo_space[0];
		break;
	case '/':
		pLogo = &new_genlogo[0];
		break;
	default:
		return;
		break;

	}
	for (int i = 0; i < 8; i++) {
		for (int j = 0; j < 128; j++) {
			hlcd.lcd[lcdNum].frame[i][j] = pLogo[cnt];
			cnt++;
		}
	}
}

void LCD_pixel_write_sizeA_p(uint8_t lcdNum, char ascii, uint8_t No)
{
  //LCDtext->size = TEXT_SIZE_A;
  // 텍스트 픽셀값 얻기
  uint8_t text[36];
  for(int i=0;i<36;i++)
  {
    text[i] = ASCII_24[ascii][i];

  }

  // 텍스트 위치 선정
  uint8_t H = 1;
  uint8_t W = 0;
  if (No >= 10)
  {
    H = 1+4;
    W = (No-10)*12;
  }
  else
  {
    W = No*12;
  }

  //   변수에 데이터 저장
  for (int i=0; i<12; i++)
	  hlcd.lcd[lcdNum].frame[H][i+W] = text[i];
     //LCDtext->data[i+W][H] = text[i];

  H++;
  for (int i=0; i<12; i++)
	  hlcd.lcd[lcdNum].frame[H][i+W] = text[i+12];
     //LCDtext->data[i+W][H] = text[i+12];
  H++;
  for (int i=0; i<12; i++)
	  hlcd.lcd[lcdNum].frame[H][i+W] = text[i+24];
     //LCDtext->data[i+W][H] = text[i+24];

}
                           
